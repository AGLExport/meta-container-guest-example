## conf/layer.conf
```bitbake
# We have a conf and classes directory, add to BBPATH
BBPATH =. "${LAYERDIR}:"

# We have recipes-* directories, add to BBFILES
BBFILES += "${LAYERDIR}/recipes-*/*/*.bb \
            ${LAYERDIR}/recipes-*/*/*.bbappend"

BBFILE_COLLECTIONS += "container-guest-example"
BBFILE_PATTERN_container-guest-example = "^${LAYERDIR}/"
BBFILE_PRIORITY_container-guest-example = "80"
LAYERSERIES_COMPAT_container-guest-example = " rocko sumo thud warrior zeus "
```
